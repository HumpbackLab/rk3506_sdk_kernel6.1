// SPDX-License-Identifier: (GPL-2.0+ OR MIT)
/*
 * RK3506G PowerFin SPI NOR: Linux on CPU0/CPU1, bare-metal Betaflight on CPU2.
 */

/dts-v1/;

#include "rk3506-powerfin-spinor.dts"
#include "rk3506-amp.dtsi"
#include "rk3506-powerfin-betaflight-amp.dtsi"

/ {
	model = "RK3506G PowerFin SPI NOR Betaflight AMP";
};
