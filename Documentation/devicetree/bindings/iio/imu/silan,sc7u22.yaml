## Documentation/devicetree/bindings/iio/imu/silan,sc7u22.yaml
```yaml
# SPDX-License-Identifier: (GPL-2.0-only OR BSD-2-Clause)
%YAML 1.2
---
$id: http://devicetree.org/schemas/iio/imu/silan,sc7u22.yaml#
$schema: http://devicetree.org/meta-schemas/core.yaml#

title: Silan SC7U22 six-axis inertial measurement unit

maintainers:
  - ncerzzk <huangcmzzk@gmail.com>

description: |
  The SC7U22 is a six-axis IMU containing a three-axis accelerometer and a
  three-axis gyroscope. This binding describes its SPI interface.

properties:
  compatible:
    const: silan,sc7u22

  reg:
    maxItems: 1

  spi-max-frequency:
    maximum: 10000000

  interrupts:
    maxItems: 1
    description: INT1 FIFO watermark interrupt.

  vdd-supply:
    description: Sensor core power supply.

  vddio-supply:
    description: Sensor digital interface power supply.

required:
  - compatible
  - reg
  - spi-max-frequency
  - interrupts
  - vdd-supply
  - vddio-supply

allOf:
  - $ref: /schemas/spi/spi-peripheral-props.yaml#

unevaluatedProperties: false

examples:
  - |
    #include <dt-bindings/interrupt-controller/irq.h>
    spi {
        #address-cells = <1>;
        #size-cells = <0>;

        imu@0 {
            compatible = "silan,sc7u22";
            reg = <0>;
            spi-max-frequency = <10000000>;
            interrupt-parent = <&gpio0>;
            interrupts = <15 IRQ_TYPE_EDGE_RISING>;
            vdd-supply = <&vcc_3v3>;
            vddio-supply = <&vcc_3v3>;
        };
    };
...
```

## Documentation/devicetree/bindings/misc/rockchip-flexbus-dshot.yaml
```yaml
# SPDX-License-Identifier: (GPL-2.0-only OR BSD-2-Clause)
%YAML 1.2
---
$id: http://devicetree.org/schemas/misc/rockchip-flexbus-dshot.yaml#
$schema: http://devicetree.org/meta-schemas/core.yaml#

title: Rockchip Flexbus DShot protocol output

maintainers:
  - Rockchip Electronics Co., Ltd.

description:
  The Rockchip Flexbus controller can generate one-bit sampled waveforms through
  its transmit channel. This binding describes a Flexbus child device that
  encodes and transmits four synchronized DShot frames on flexbus0 data outputs.
  The driver uses a 4-bit Flexbus transfer width, with data bit 0 through bit 3
  mapped to DShot channel 0 through channel 3.

properties:
  compatible:
    const: rockchip,rk3506-flexbus-dshot

  rockchip,dshot-rate:
    description:
      DShot bit rate in Hz. Common values are 150000, 300000, 600000 and
      1200000. If omitted, DShot600 is used.
    minimum: 150000
    maximum: 1200000
    default: 600000

  rockchip,telemetry:
    description:
      Enable the telemetry request bit in transmitted DShot frames by default.
    type: boolean

required:
  - compatible

unevaluatedProperties: false

examples:
  - |
    #include <dt-bindings/mfd/rockchip-flexbus.h>

    flexbus@ff880000 {
        compatible = "rockchip,rk3506-flexbus";
        reg = <0xff880000 0x200>;
        rockchip,flexbus0-opmode = <ROCKCHIP_FLEXBUS0_OPMODE_DSHOT>;
        rockchip,flexbus1-opmode = <ROCKCHIP_FLEXBUS1_OPMODE_NULL>;

        dshot {
            compatible = "rockchip,rk3506-flexbus-dshot";
            rockchip,dshot-rate = <600000>;
        };
    };

...
```

## Documentation/devicetree/bindings/pwm/rockchip,pwm-wave.yaml
```yaml
# SPDX-License-Identifier: (GPL-2.0-only OR BSD-2-Clause)
%YAML 1.2
---
$id: http://devicetree.org/schemas/pwm/rockchip,pwm-wave.yaml#
$schema: http://devicetree.org/meta-schemas/core.yaml#

title: Userspace interface for a Rockchip PWM wave-table generator

maintainers:
  - Rockchip Linux <linux@rock-chips.com>

description:
  Exposes the lookup-table waveform generator in a Rockchip PWM v4 channel
  through a character device. The waveform format, period and lookup-table
  contents are runtime properties and are not represented in the device tree.

properties:
  compatible:
    const: rockchip,pwm-wave

  pwms:
    maxItems: 1

required:
  - compatible
  - pwms

additionalProperties: false

examples:
  - |
    pwm-wave {
        compatible = "rockchip,pwm-wave";
        pwms = <&pwm0 0 1250 0>;
    };

...
```

## drivers/accesstokenid/Kconfig
```kconfig
# SPDX-License-Identifier: GPL-2.0
config ACCESS_TOKENID
	bool "Access task's token"
	default n
	help
	  Provide the OpenHarmony access-token misc device and per-task token
	  storage used to propagate caller identity through Binder transactions.
```

## drivers/misc/rockchip/Kconfig
```kconfig
# SPDX-License-Identifier: GPL-2.0
#
# Misc strange devices for rockchip

config PCIE_FUNC_RKEP
	tristate "Rockchip PCIe EP function driver"
	depends on PCI
	depends on ARCH_ROCKCHIP
	select PCIE_DW_DMATEST
	help
           Enable this configuration option to enable the host side function
	   driver for Rockchip's EP demo function driver.

config PCIE_FUNC_RKEP_USERPAGES
	bool "EP function driver reserve continuous physical space for user layer"
	depends on PCIE_FUNC_RKEP=y
	help
	  Enable this configuration option to reserve continuous physical space
          for user layer in Rockchip's EP demo function driver.

config ROCKCHIP_FLEXBUS_DSHOT
	tristate "Rockchip Flexbus DShot protocol driver"
	depends on ARCH_ROCKCHIP
	depends on OF
	select MFD_ROCKCHIP_FLEXBUS
	help
	  Select this to drive four DShot outputs through Rockchip Flexbus0.

	  The driver exposes a misc character device. Writing a throttle value
	  sends one DShot frame; ioctls can select the DShot bit rate, telemetry
	  bit and raw 11-bit command value. On boards that wire flexbus0 outputs
	  back to flexbus1 inputs through the ESC signal lines, the misc device
	  decodes bidirectional DShot electrical RPM telemetry and also supports a
	  raw sampled passthrough ioctl for ESC configuration tools such as
	  BLHeliSuite32 and AM32 configurators.
```
